## src/drivers/hpm_tsns/Kconfig
```kconfig
menuconfig DRIVERS_HPM_TSNS
	bool "hpm_tsns"
	default n
	---help---
		Driver for the HPM6E80 on-die temperature sensor (TSNS).

		The die temperature is published once per second through the
		debug_key_value topic with the key "SOC_TEMP".  The logger records it
		and MAVLink forwards it to the ground station as NAMED_VALUE_FLOAT.
```

## src/systemcmds/pwmv2test/Kconfig
```kconfig
menuconfig SYSTEMCMDS_PWMV2TEST
	bool "pwmv2test"
	default n
	---help---
		Drive a PWMv2 output on the HPM6E00EVK.  By default it generates a
		1 kHz, 50% waveform on PWM1 channel 7 (PE15, green LED), which is the
		simplest way to validate the PWMv2 bring-up without the mixer.
```

## src/systemcmds/spitest/Kconfig
```kconfig
menuconfig SYSTEMCMDS_SPITEST
	bool "spitest"
	default n
	---help---
		SPI master/slave loopback test.  On the HPM6E00EVK it drives SPI7 as
		master (PF26/PF29/PF28, CS on PF25) against SPI0 as slave
		(PE10/PE13/PE12/PE11) and verifies both directions.
```
